## config/west.yml
```yaml
manifest:
  version: 1.2
  defaults:
    remote: cormoran
    revision: main
  remotes:
    - name: cormoran
      url-base: https://github.com/cormoran
    - name: zmkfirmware
      url-base: https://github.com/zmkfirmware
    - name: sekigon-gonnoc
      url-base: https://github.com/sekigon-gonnoc
  projects:
    - name: zmk
      import:
        file: app/west.yml
      clone-depth: 1
      revision: main+dya
    - name: zephyr
      revision: v4.1.0+zmk-fixes+nrf-half-duplex-uart
      clone-depth: 1
      import:
        name-blocklist:
          - ci-tools
          - hal_altera
          - hal_cypress
          - hal_infineon
          - hal_microchip
          - hal_nxp
          - hal_openisa
          - hal_silabs
          - hal_xtensa
          - hal_st
          - hal_ti
          - loramac-node
          - mcumgr
          - net-tools
          - openthread
          - edtt
          - trusted-firmware-m
    - name: zmk-driver-paw3222
      remote: sekigon-gonnoc
      revision: main
    - name: zmk-module-ble-management
    - name: zmk-module-battery-history
    - name: zmk-module-settings-rpc
    - name: zmk-module-runtime-input-processor
    - name: zmk-behavior-runtime-sensor-rotate
      revision: feat/custom-settings-storage
    - name: zmk-feature-input-stream
    - name: zmk-feature-module-physical-layout
    - name: zmk-feature-custom-settings
    - name: zmk-feature-device-info
    - name: zmk-feature-kscan-diagnostics
    - name: zmk-feature-watchdog
  self:
    path: config
```
